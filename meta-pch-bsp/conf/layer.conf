## meta-pch-bsp/conf/machine/c200.conf
```bitbake
#@TYPE: Machine
#@NAME: Dreambox DM 8000 HD PVR
#@DESCRIPTION: Machine configuration for the Dreambox DM 8000 HD PVR

DREAMBOX_FEATURES = "ci dvd"
MACHINE_FEATURES += "pci"
SOC_FAMILY = "bcm7400"

require conf/machine/include/pch-mips32el.inc
```

## meta-pch-bsp/conf/machine/include/pch-mips32el.inc
```bitbake
# pch-mips32el.inc

DREAMBOX_KERNEL_VERSION = "2.6.22"
LINUXLIBCVERSION = "2.6.22"
OLDEST_KERNEL = "2.6"

TARGET_ARCH = "mipsel"
DEFAULTTUNE = "74kc"

require conf/machine/include/pch.inc
require conf/machine/include/tune-74kc.inc
```

## meta-pch-bsp/conf/machine/include/pch.inc
```bitbake
# pch.inc

GLIBC_EXTRA_OECONF = "--with-tls --with-__thread"

MACHINE_FEATURES += "kernel26"

PREFERRED_PROVIDER_virtual/kernel = "linux-pch"
```

## meta-pch-bsp/conf/machine/include/tune-74kc.inc
```bitbake
# tune-74kc.inc
DEFAULTTUNE ?= "74kc"

require conf/machine/include/tune-mips32.inc

AVAILTUNES += "74kc"
TUNEVALID[74kc] = "Enable mips 74K specific processor optimizations"
TUNE_CONFLICTS[74kc] = "n64 n32"
TUNE_FEATURES_tune-74kc = "${TUNE_FEATURES_tune-mipsel} 74kc"
TUNE_CCARGS += "${@bb.utils.contains("TUNE_FEATURES", "74kc", "-march=74kc -mdsp -fPIC", "", d)}"

MIPSPKGSFX_VARIANT_tune-74kc = "mips32el"
PACKAGE_EXTRA_ARCHS_tune-74kc = "mipsel mips32el"
```
